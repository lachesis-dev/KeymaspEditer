// ============================================================
// config/totem_left.overlay
// 左半分 (Central) XIAO nRF52840 オーバーレイ
// ============================================================

// ---- ADC: バッテリー電圧読み取り (XIAO BLE 固有) ----
&adc {
    status = "okay";
};

/ {
    vbatt: vbatt {
        compatible = "zmk,battery-voltage-divider";
        io-channels = <&adc 7>;
        output-ohms = <2000000>;
        full-ohms = <(2000000 + 806000)>;
    };
};

// ============================================================
// ドングル構成に変更する場合:
// このファイルは左がPeripheralになっても変更不要。
// バッテリー表示はそのまま有効でよい。
// ============================================================
