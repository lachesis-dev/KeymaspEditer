## config/boards/shields/thorium34/Kconfig.defconfig
```kconfig
# Copyright (c) 2022 The ZMK Contributors
# SPDX-License-Identifier: MIT

if SHIELD_TOTEM_LEFT

config ZMK_KEYBOARD_NAME
    default "THORIUM34"
    
config ZMK_SPLIT_ROLE_CENTRAL
    default y

endif

if SHIELD_THORIUM34_LEFT || SHIELD_THORIUM34_RIGHT

config ZMK_SPLIT
    default y

endif
```
